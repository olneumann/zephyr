## drivers/sensor/melexis/Kconfig
```kconfig
# zephyr-keep-sorted-start
source "drivers/sensor/melexis/mlx90393/Kconfig"
source "drivers/sensor/melexis/mlx90395/Kconfig"
# zephyr-keep-sorted-stop
```

## drivers/sensor/melexis/mlx90393/Kconfig
```kconfig
# MLX90393 Kconfig

# Copyright (c) 2024 Oliver Neumann
# SPDX-License-Identifier: Apache-2.0

menuconfig MLX90393
	bool "MLX90393 Three Axis Magnetometer"
	default y
	depends on DT_HAS_MELEXIS_MLX90393_ENABLED
	select I2C if $(dt_compat_on_bus,$(DT_COMPAT_MELEXIS_MLX90393),i2c)
	help
	  Enable support for the MLX90393 Three Axis Magnetometer.
```

## drivers/sensor/melexis/mlx90395/Kconfig
```kconfig
# MLX90395 Kconfig

# Copyright (c) 2024 Oliver Neumann
# SPDX-License-Identifier: Apache-2.0

menuconfig MLX90395
	bool "MLX90395 Three Axis Magnetometer"
	default y
	depends on DT_HAS_MELEXIS_MLX90395_ENABLED
	select I2C if $(dt_compat_on_bus,$(DT_COMPAT_MELEXIS_MLX90395),i2c)
	help
	  Enable support for the MLX90395 Three Axis Magnetometer.
```

## drivers/sensor/memsic/Kconfig
```kconfig
# zephyr-keep-sorted-start
source "drivers/sensor/memsic/mc3419/Kconfig"
source "drivers/sensor/memsic/mmc5983ma/Kconfig"
# zephyr-keep-sorted-stop
```

## drivers/sensor/memsic/mmc5983ma/Kconfig
```kconfig
# MMC5983MA Kconfig

# Copyright (c) 2024 Oliver Neumann
# SPDX-License-Identifier: Apache-2.0

menuconfig MMC5983MA
	bool "MMC5983MA Three Axis Magnetometer"
	default y
	depends on DT_HAS_MEMSIC_MMC5983MA_ENABLED
	select I2C if $(dt_compat_on_bus,$(DT_COMPAT_MEMSIC_MMC5983MA),i2c)
	help
	  Enable support for the MMC5983MA Three Axis Magnetometer.
```

## drivers/sensor/tdk/icm20948/Kconfig
```kconfig
# Kconfig - ICM20948 sensor driver
# SPDX-License-Identifier: Apache-2.0

menuconfig ICM20948
	bool "Custom ICM20948 sensor driver"
	default y
	depends on DT_HAS_INVENSENSE_ICM20948_ENABLED
	select I2C if $(dt_compat_on_bus,$(DT_COMPAT_INVENSENSE_ICM20948),i2c)
	help
	  Enable ICM20948 sensor
    
```

## dts/bindings/sensor/melexis,mlx90393.yaml
```yaml
# SPDX-License-Identifier: Apache-2.0
# Copyright (c) 2023 Linumiz

description: |
  Melexis MLX90393 3-axis magnetometer sensor accessed through I2C bus

compatible: "melexis,mlx90393"

include: [sensor-device.yaml, i2c-device.yaml]

# properties:
#   bandwidth:
#     type: int
#     default: 0
#     description: |
#       Specify the default bandwidth expressed in Hz.

#       - 100 # MMC5983MA_MBW_100Hz
#       - 200 # MMC5983MA_MBW_200Hz
#       - 400 # MMC5983MA_MBW_400Hz
#       - 800 # MMC5983MA_MBW_800Hz

#     enum: [100, 200, 400, 800]

#   frequency:
#     type: int
#     default: 0
#     description: |
#       Specify the default continuous measurement frequency expressed in Hz.

#       - 0     # MMC5983MA_FREQ_ONESHOT
#       - 1     # MMC5983MA_FREQ_1Hz
#       - 10    # MMC5983MA_FREQ_10Hz
#       - 20    # MMC5983MA_FREQ_20Hz
#       - 50    # MMC5983MA_FREQ_50Hz
#       - 100   # MMC5983MA_FREQ_100Hz
#       - 200   # MMC5983MA_FREQ_200Hz
#       - 1000  # MMC5983MA_FREQ_1000Hz

#     enum: [0, 1, 10, 20, 50, 100, 200, 1000]

#   prd-set:
#     type: int
#     default: 0
#     description: |
#       This value determines how often the chip will do a set operation. This will allow large set current to flow throug hthe sensor couls for 500ns. 

#       - 1     # MMC5983MA_PRD_SET_1ms
#       - 25    # MMC5983MA_PRD_SET_25ms
#       - 75    # MMC5983MA_PRD_SET_75ms
#       - 100   # MMC5983MA_PRD_SET_100ms
#       - 250   # MMC5983MA_PRD_SET_250ms
#       - 500   # MMC5983MA_PRD_SET_500ms
#       - 1000  # MMC5983MA_PRD_SET_1000ms
#       - 2000  # MMC5983MA_PRD_SET_2000ms

#     enum: [1, 25, 75, 100, 250, 500, 1000, 2000]
```

## dts/bindings/sensor/melexis,mlx90395.yaml
```yaml
# SPDX-License-Identifier: Apache-2.0
# Copyright (c) 2023 Linumiz

description: |
  Melexis MLX90395 3-axis magnetometer sensor accessed through I2C bus

compatible: "melexis,mlx90395"

include: [sensor-device.yaml, i2c-device.yaml]
```

## dts/bindings/sensor/memsic,mmc5983ma.yaml
```yaml
# SPDX-License-Identifier: Apache-2.0
# Copyright (c) 2023 Linumiz

description: |
  MEMSIC MMC5983MA 3-axis magnetometer sensor accessed through I2C bus

compatible: "memsic,mmc5983ma"

include: [sensor-device.yaml, i2c-device.yaml]

properties:
  int-gpios:
    type: phandle-array
    description: |
      This property specifies the connection for INT, this pin
      defaults to active low when sample produce interrupt.

  int-pin2:
    type: boolean
    description: |
      This property is used for interrupt routing.The sensor
      has two interrupt pins.By default the interrupt are routed
      to interrupt pin 1, by enabled this property interrupt are
      routed to interrupt pin 2.
```

## dts/bindings/sensor/tdk,icm20948.yaml
```yaml
description: |
    TDK ICM20948 9-axis IMU (Inertial Measurement Unit) sensor
    accessed through I2C bus

compatible: "tdk,icm20948"

include: ["i2c-device.yaml"]
```
